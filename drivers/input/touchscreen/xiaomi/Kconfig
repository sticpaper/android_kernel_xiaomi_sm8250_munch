## drivers/input/touchscreen/xiaomi/Kconfig
```kconfig
config TOUCHSCREEN_XIAOMI_TOUCHFEATURE
	tristate "Xiaomi Touch Feature"
	depends on INPUT_TOUCHSCREEN
	help
	  Say Y here if you enable xiaomi touch feature.

	  If unsure, say N.

	  To compile this driver as a module, choose M here:

config TOUCHSCREEN_SUPPORT_NEW_GAME_MODE
	bool "Touch Support New Game Mode"
	help
	  Say Y here if the device support new game mode

	  If not support, say N.

config TOUCHSCREEN_XIAOMI_GAMEMODE_NODE
	bool "Touch Export Gamemode node into tp_common"
	depends on TOUCHSCREEN_COMMON
	help
	  Say Y here export gamemode node into tp_common

	  If not support, say N.
```
